## Kconfig
```kconfig
source "app/Kconfig"
source "bsp/Kconfig"
source "drivers/Kconfig"
source "mm/Kconfig"

choice
	prompt "Select A Running Target"

	config SELECT_QEMU
		tristate "Select QEMU"
	config SELECT_FPGA
		tristate "Select NanHu FPGA"
	config SELECT_KMH_FPGA
		tristate "Select KunMingHu FPGA"
	config SELECT_VCS
		tristate "Select VCS"
endchoice

choice
	prompt "Select irqchip"

	config SELECT_AIA
		tristate "Select AIA"
	config SELECT_PLIC
		tristate "Select PLIC"
endchoice

choice
	prompt "Use 4K/2M/1G in direct mapping"
	config SELECT_4K_DIRECT_MAPPING
		tristate "Select 4k mapping"
	config SELECT_2M_DIRECT_MAPPING
		tristate "Select 2m mapping"
	config SELECT_1G_DIRECT_MAPPING
		tristate "Select 1g mapping"
endchoice

choice
	prompt "Use 4K/2M/1G in code mapping"
	config SELECT_4K_CODE_MAPPING
		tristate "Select 4k mapping"
	config SELECT_2M_CODE_MAPPING
		tristate "Select 2m mapping"
	config SELECT_1G_CODE_MAPPING
		tristate "Select 1g mapping"
endchoice

config VIRT
	bool "Virt"
	default y
	if VIRT
		source "virt/Kconfig"
	endif

config USER
	bool "User"
	default y

config MYGUEST
	bool "Guest OS bin"
	default y

config MYUSER
	bool "User process bin"
	default y

config ENABLE_MMU
	bool "Enable MMU"
	default y

config SVNAPOT
	bool "Enable svnapot"
	depends on ENABLE_MMU
	depends on SELECT_SV39

config ENABLE_MULTI_TASK
	bool "Enable Multi task"
	default y

config TASK_SCHEDULER_PERIOD
	int "Task scheduler period(ms)"
	default "100"
	depends on ENABLE_MULTI_TASK

config ENABLE_SHELL
	bool "Enable Shell"
	default y
```

## app/command/Kconfig
```kconfig
config APP_CSR_CTL
	bool "APP_CSR_CTL"
config APP_DEVICES
	bool "APP_DEVICES"
config APP_DEVMEM
	bool "APP_DEVMEM"
config APP_DMA_TEST
	bool "APP_DMA_TEST"
config APP_HELLO
	bool "APP_HELLO"
config APP_HISTORY
	bool "APP_HISTORY"
config APP_IMSIC_TEST
	bool "APP_IMSIC_TEST"
	depends on SELECT_AIA
	depends on AIA
config APP_VS_IMSIC_MULTI_TEST
	bool "APP_VS_IMSIC_MULTI_TEST"
	depends on VIRT
	depends on SELECT_AIA
	depends on AIA
config APP_LS
	bool "APP_LS"
config APP_MEM_READ
	bool "APP_MEM_READ"
config APP_PAGE_TLB_TEST
	bool "APP_PAGE_TLB_TEST"
	depends on ENABLE_MMU
config APP_PLIC_SET_AFFINITY
	bool "APP_PLIC_SET_AFFINITY"
config APP_SPINLOCK_TEST
	bool "APP_SPINLOCK_TEST"
config APP_TASK_INFO
	bool "APP_TASK_INFO"
config APP_USER_RUN
	bool "APP_USER_RUN"
	depends on USER
config APP_USER_RUN_EXT
	bool "APP_USER_RUN_EXT"
	depends on USER
config APP_USER_INFO
	bool "APP_USER_INFO"
	depends on USER
config APP_VCPU_RUN
	bool "APP_VCPU_RUN"
	depends on VIRT
config APP_VCPU_RUN_EXT
	bool "APP_VCPU_RUN_EXT"
	depends on VIRT
config APP_VCPU_INFO
	bool "VCPU_INFO"
	depends on VIRT
config APP_STREAM
	bool "APP_STREAM"
config APP_HUGE_PAGE_TEST
	bool "APP_HUGE_PAGE_TEST"
config APP_TINY_TEST
	bool "APP_TINY_TEST"
	depends on TINY
config APP_PLANE
	bool "A Plane Game"
	default n
config APP_GET_PTE_TEST
	bool "Get Pte Test"
	default n
config APP_SVNAPOT_TEST
	bool "APP_SVNAPOT_TEST"
	depends on SVNAPOT
	default n
config MULTICORE_TEST
	bool "Multicore_test"
config APP_FLOAT_TEST
	bool "APP_FLOAT_TEST"
config APP_MEM_WALK
	bool "APP_MEM_WALK"
config APP_STVAL
	bool "APP_STVAL"
config APP_CMD_LOADER
	bool "APP_CMD_LOADER"
	default y
config APP_MEM_TESTER
	bool "APP_MEM_TESTER"
config APP_G_STAGE_TEST
	bool "APP_G_STAGE_TEST"
	depends on VIRT
	default y
config APP_SVPBMT_TEST
	bool "APP_SVPBMT_TEST"
	depends on ENABLE_SVPBMT
	default y
config APP_SCAN_MEM_TEST
	bool "APP_SCAN_MEM_TEST"
	default y
config APP_RESV_MEM_INFO
	bool "APP_RESV_MEM_INFO"
	default y
config APP_CACHE_FLUSH_TEST
	bool "APP_CACHE_FLUSH_TEST"
	depends on ENABLE_ZICBOM 
	default y
config APP_SINVAL_TEST
	bool "APP_SINVAL_TEST"
	default y
config APP_ZICOND_TEST
	bool "APP_ZICOND_TEST"
	default y
config APP_HPM_TEST
	bool "APP_HPM_TEST"
	default y
config APP_LSPCI
	bool "APP_LSPCI"
	depends on PCI
	default y
config APP_LSDMAC
	bool "APP_LSDMAC"
	default y
config APP_STUB_TEST
	bool "APP_STUB_TEST"
	default y
config APP_INTR_TEST
	bool "APP_INTR_TEST"
	depends on SELECT_VCS
	default y
config APP_IPI_TEST
	bool "APP_IPI_TEST"
	default y
menuconfig MULTICORE_MEMORY_TEST
	bool "MULTI_CORE_MEMORY_TEST"
	default y
	if MULTICORE_MEMORY_TEST
		source "app/command/multicore_memory_test/Kconfig"
	endif

if !ENABLE_MULTI_TASK
config APP_WFI_TEST
	bool "APP_WFI_TEST"
	default y
endif

if !ENABLE_MMU && !IOMMU
config APP_IOMMU_LIB_TEST
	bool "APP_IOMMU_LIB_TEST"
	default n

endif
```

## drivers/Kconfig
```kconfig
menu "drivers"
menuconfig DMAC
	bool "DMAC drivers"
	default y
	if DMAC
		source "drivers/dmac/Kconfig"
	endif
menuconfig IMSIC_TEST
	bool "IMISC test driver"
	default y
	if IMSIC_TEST
		source "drivers/imsic-test/Kconfig"
	endif
menuconfig IOMMU
	bool "IOMMU driver"
	default y
	if IOMMU
		source "drivers/iommu/Kconfig"
	endif
menuconfig IRQCHIP
	bool "IRQCHIP support"
	default y
	if IRQCHIP
		source "drivers/irqchip/Kconfig"
	endif
menuconfig TIMER
	bool "TIMER support"
	default y
	if TIMER
		source "drivers/timer/Kconfig"
	endif
menuconfig UART
	bool "UART drivers"
	default y
	if UART
		source "drivers/uart/Kconfig"
	endif
config PCI
	bool "Pcie drivers"
	default y
endmenu
```

## drivers/display/Kconfig
```kconfig
menu "display"
config CHR_DISPLAY
	bool "Char Display Drivers"
	default n
endmenu
```

## drivers/dmac/Kconfig
```kconfig
config DMAC_DW_AXI_DRIVER
	bool "DRIVER_DMAC_DW_AXI"
	default y

config DMAC_MY_PCI_DMAENGINE_DRIVER
	bool "DRIVER_MY_PCI_DMAENGINE"
	default y
```

## drivers/irqchip/Kconfig
```kconfig
menu "aia"
config AIA
	bool "AIA driver"
	default y
	if AIA
		source "drivers/irqchip/aia/Kconfig"
	endif
endmenu

menu "plic"
config PLIC
	bool "PLIC driver"
	default y
endmenu
```

## drivers/irqchip/aia/Kconfig
```kconfig
config AIA_APLIC
	bool "aplic driver"
	default y

config AIA_IMSIC
	bool "imsic driver"
	default y
```

## drivers/uart/Kconfig
```kconfig
config NS16550A
	bool "DRIVER_UART_NS16550A"
	default y

config QEMU_8250
	bool "DRIVER_UART_QEMU_8250"
	default y

config UARTLITE
	bool "DRIVER_UART_UARTLITE"
	default y
```

## mm/Kconfig
```kconfig
menu "Memory Management"

config TINY
	bool "Enable Tiny mm"
	default y

endmenu
```

## virt/Kconfig
```kconfig
menu "virt"
menuconfig VIRT_ENABLE_TIMER
	bool "VIRT_TIMER"
	default y

menuconfig VIRT_ENABLE_AIA
	bool "VIRT_AIA"
	depends on SELECT_AIA
	default y

choice
	prompt "Select Virt uart"

	config VIRT_UART_8250
		tristate "Select qemu-8250"
	config VIRT_UART_UARTLITE
		tristate "Select uartlite"
	config VIRT_UART_NS16550A
		tristate "Select ns16550a"
endchoice

choice
	prompt "Use 4K/2M/1G in guest memory gstage mapping"
	config SELECT_4K_GUEST_MEM_MAPPING
		tristate "Select 4k mapping"
	config SELECT_2M_GUEST_MEM_MAPPING
		tristate "Select 2m mapping"
	config SELECT_1G_GUEST_MEM_MAPPING
		tristate "Select 1g mapping"
endchoice

source "virt/virt_machine_Kconfig"

endmenu
```
